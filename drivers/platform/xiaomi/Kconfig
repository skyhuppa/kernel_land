## drivers/platform/xiaomi/Kconfig
```kconfig
# Infinix configuration options

config MACH_INFINIX_MSM8937
	bool "Infinix MSM8937"
	depends on ARCH_MSM8937
	help
	  Support for MSM8937 Infinix variants

menu "Infinix board selection"

config MACH_INFINIX_X573
	bool "X573 board"
	select MACH_INFINIX_MSM8937
	help
	  Support for Infinix Hot S3

endmenu
```
