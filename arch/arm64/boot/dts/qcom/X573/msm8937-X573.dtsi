#include "msm-audio-X573.dtsi"
#include "msm8937-camera-X573.dtsi"
#include "msm8937-camera-sensor-qrd-X573.dtsi"
#include "msm8937-display-X573.dtsi"
#include "msm8937-general-X573.dtsi"
#include "msm8937-memory-X573.dtsi"
#include "msm8937-regulator-X573.dtsi"
